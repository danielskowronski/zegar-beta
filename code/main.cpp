#include <Wire.h>
#include <Rtc_Pcf8563.h>
#include <DHT.h>
#include <MemoryFree.h>

char cha[25];
int contrast_val=0;

#define DHTPIN 2 
#define DHTTYPE DHT11

#define PIN_SCE   7
#define PIN_RESET 13
#define PIN_DC    6
#define PIN_SDIN  5
#define PIN_SCLK  4

#define LCD_C     LOW
#define LCD_D     HIGH

#define LCD_X     84
#define LCD_Y     48

static const byte ASCII[][5] =
{
 {0x00, 0x00, 0x00, 0x00, 0x00} // 20  
,{0x00, 0x00, 0x5f, 0x00, 0x00} // 21 !
,{0x00, 0x07, 0x00, 0x07, 0x00} // 22 "
,{0x14, 0x7f, 0x14, 0x7f, 0x14} // 23 #
,{0x24, 0x2a, 0x7f, 0x2a, 0x12} // 24 $
,{0x23, 0x13, 0x08, 0x64, 0x62} // 25 %
,{0x36, 0x49, 0x55, 0x22, 0x50} // 26 &
,{0x00, 0x05, 0x03, 0x00, 0x00} // 27 '
,{0x00, 0x1c, 0x22, 0x41, 0x00} // 28 (
,{0x00, 0x41, 0x22, 0x1c, 0x00} // 29 )
,{0x14, 0x08, 0x3e, 0x08, 0x14} // 2a *
,{0x08, 0x08, 0x3e, 0x08, 0x08} // 2b +
,{0x00, 0x50, 0x30, 0x00, 0x00} // 2c ,
,{0x08, 0x08, 0x08, 0x08, 0x08} // 2d -
,{0x00, 0x60, 0x60, 0x00, 0x00} // 2e .
,{0x20, 0x10, 0x08, 0x04, 0x02} // 2f /
,{0x3e, 0x51, 0x49, 0x45, 0x3e} // 30 0
,{0x00, 0x42, 0x7f, 0x40, 0x00} // 31 1
,{0x42, 0x61, 0x51, 0x49, 0x46} // 32 2
,{0x21, 0x41, 0x45, 0x4b, 0x31} // 33 3
,{0x18, 0x14, 0x12, 0x7f, 0x10} // 34 4
,{0x27, 0x45, 0x45, 0x45, 0x39} // 35 5
,{0x3c, 0x4a, 0x49, 0x49, 0x30} // 36 6
,{0x01, 0x71, 0x09, 0x05, 0x03} // 37 7
,{0x36, 0x49, 0x49, 0x49, 0x36} // 38 8
,{0x06, 0x49, 0x49, 0x29, 0x1e} // 39 9
,{0x00, 0x36, 0x36, 0x00, 0x00} // 3a :
,{0x00, 0x56, 0x36, 0x00, 0x00} // 3b ;
,{0x08, 0x14, 0x22, 0x41, 0x00} // 3c <
,{0x14, 0x14, 0x14, 0x14, 0x14} // 3d =
,{0x00, 0x41, 0x22, 0x14, 0x08} // 3e >
,{0x02, 0x01, 0x51, 0x09, 0x06} // 3f ?
,{0x32, 0x49, 0x79, 0x41, 0x3e} // 40 @
,{0x7e, 0x11, 0x11, 0x11, 0x7e} // 41 A
,{0x7f, 0x49, 0x49, 0x49, 0x36} // 42 B
,{0x3e, 0x41, 0x41, 0x41, 0x22} // 43 C
,{0x7f, 0x41, 0x41, 0x22, 0x1c} // 44 D
,{0x7f, 0x49, 0x49, 0x49, 0x41} // 45 E
,{0x7f, 0x09, 0x09, 0x09, 0x01} // 46 F
,{0x3e, 0x41, 0x49, 0x49, 0x7a} // 47 G
,{0x7f, 0x08, 0x08, 0x08, 0x7f} // 48 H
,{0x00, 0x41, 0x7f, 0x41, 0x00} // 49 I
,{0x20, 0x40, 0x41, 0x3f, 0x01} // 4a J
,{0x7f, 0x08, 0x14, 0x22, 0x41} // 4b K
,{0x7f, 0x40, 0x40, 0x40, 0x40} // 4c L
,{0x7f, 0x02, 0x0c, 0x02, 0x7f} // 4d M
,{0x7f, 0x04, 0x08, 0x10, 0x7f} // 4e N
,{0x3e, 0x41, 0x41, 0x41, 0x3e} // 4f O
,{0x7f, 0x09, 0x09, 0x09, 0x06} // 50 P
,{0x3e, 0x41, 0x51, 0x21, 0x5e} // 51 Q
,{0x7f, 0x09, 0x19, 0x29, 0x46} // 52 R
,{0x46, 0x49, 0x49, 0x49, 0x31} // 53 S
,{0x01, 0x01, 0x7f, 0x01, 0x01} // 54 T
,{0x3f, 0x40, 0x40, 0x40, 0x3f} // 55 U
,{0x1f, 0x20, 0x40, 0x20, 0x1f} // 56 V
,{0x3f, 0x40, 0x38, 0x40, 0x3f} // 57 W
,{0x63, 0x14, 0x08, 0x14, 0x63} // 58 X
,{0x07, 0x08, 0x70, 0x08, 0x07} // 59 Y
,{0x61, 0x51, 0x49, 0x45, 0x43} // 5a Z
,{0x00, 0x7f, 0x41, 0x41, 0x00} // 5b [
,{0x00, 0x05, 0x05, 0x05, 0x00} // 5c ¥
,{0x00, 0x41, 0x41, 0x7f, 0x00} // 5d ]
,{0x04, 0x02, 0x01, 0x02, 0x04} // 5e ^
,{0x40, 0x40, 0x40, 0x40, 0x40} // 5f _
,{0x00, 0x01, 0x02, 0x04, 0x00} // 60 `
,{0x20, 0x54, 0x54, 0x54, 0x78} // 61 a
,{0x7f, 0x48, 0x44, 0x44, 0x38} // 62 b
,{0x38, 0x44, 0x44, 0x44, 0x20} // 63 c
,{0x38, 0x44, 0x44, 0x48, 0x7f} // 64 d
,{0x38, 0x54, 0x54, 0x54, 0x18} // 65 e
,{0x08, 0x7e, 0x09, 0x01, 0x02} // 66 f
,{0x0c, 0x52, 0x52, 0x52, 0x3e} // 67 g
,{0x7f, 0x08, 0x04, 0x04, 0x78} // 68 h
,{0x00, 0x44, 0x7d, 0x40, 0x00} // 69 i
,{0x20, 0x40, 0x44, 0x3d, 0x00} // 6a j 
,{0x7f, 0x10, 0x28, 0x44, 0x00} // 6b k
,{0x00, 0x41, 0x7f, 0x40, 0x00} // 6c l
,{0x7c, 0x04, 0x18, 0x04, 0x78} // 6d m
,{0x7c, 0x08, 0x04, 0x04, 0x78} // 6e n
,{0x38, 0x44, 0x44, 0x44, 0x38} // 6f o
,{0x7c, 0x14, 0x14, 0x14, 0x08} // 70 p
,{0x08, 0x14, 0x14, 0x18, 0x7c} // 71 q
,{0x7c, 0x08, 0x04, 0x04, 0x08} // 72 r
,{0x48, 0x54, 0x54, 0x54, 0x20} // 73 s
,{0x04, 0x3f, 0x44, 0x40, 0x20} // 74 t
,{0x3c, 0x40, 0x40, 0x20, 0x7c} // 75 u
,{0x1c, 0x20, 0x40, 0x20, 0x1c} // 76 v
,{0x3c, 0x40, 0x30, 0x40, 0x3c} // 77 w
,{0x44, 0x28, 0x10, 0x28, 0x44} // 78 x
,{0x0c, 0x50, 0x50, 0x50, 0x3c} // 79 y
,{0x44, 0x64, 0x54, 0x4c, 0x44} // 7a z
,{0x00, 0x08, 0x36, 0x41, 0x00} // 7b {
,{0x00, 0x00, 0x7f, 0x00, 0x00} // 7c |
,{0x00, 0x41, 0x36, 0x08, 0x00} // 7d }
,{0x10, 0x08, 0x08, 0x10, 0x08} // 7e ←
,{0x78, 0x46, 0x41, 0x46, 0x78} // 7f →
};
static const byte BigNumber[][42] =
{
0x00, 0x00, 0x00, 0x00, 0x00, 0x00, 0x00, 0x00, 0x00, 0x00, 0x00, 0x00,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 0x00,   // -
0x00, 0x00, 0x00, 0x00, 0x00, 0x00, 0x00, 0x00, 0x00, 0x00, 0x00, 0x00,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 0x00,   // .
0x00, 0x00, 0x02, 0x06, 0x0e, 0x0e, 0x0e, 0x0e, 0x0e, 0x0e, 0x06, 0x02,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 0x00,   // /
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0x00, 0x00, 0x00, 0x00, 0x00, 0x00, 0x40, 0xe0, 0xe0, 0x40, 0x00, 0x00,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 0x00,   // : //<-14
};


void LcdCharacter(char character, bool negate)
{
  if (negate) LcdWrite(LCD_D, 0xff); else LcdWrite(LCD_D, 0x00);
  for (int index = 0; index < 5; index++)
  {
    byte b=ASCII[character - 0x20][index]; if (negate) b=~b;
    LcdWrite(LCD_D, b);
  }
  if (negate) LcdWrite(LCD_D, 0xff); else LcdWrite(LCD_D, 0x00);
}
void LcdCharacterBig (int x, int y,char character, bool negate){
  int c = character-48+3;
  if (character=='.') c=1;
  if (character=='-') c=0;
  if (character==':') c=14; //seems not to work correctly

  for (int index = 0; index < 42; index++) {
    gotoXY(x+(index%14), y+index/14);
    byte b=BigNumber[c][index]; if (negate) b=~b;
    LcdWrite(LCD_D, b);
  }
}


void LcdInitialise(void)
{
  pinMode(PIN_SCE, OUTPUT);
  pinMode(PIN_RESET, OUTPUT);
  pinMode(PIN_DC, OUTPUT);
  pinMode(PIN_SDIN, OUTPUT);
  pinMode(PIN_SCLK, OUTPUT);
  digitalWrite(PIN_RESET, LOW);
  digitalWrite(PIN_RESET, HIGH);
  LcdWrite(LCD_C, 0x21 );  // LCD Extended Commands.
  LcdWrite(LCD_C, 0xBA+contrast_val+5 );  // Set LCD Vop (Contrast). 
  LcdWrite(LCD_C, 0x04 );  // Set Temp coefficent. //0x04
  LcdWrite(LCD_C, 0x13 );  // LCD bias mode 1:48. //0x13
  LcdWrite(LCD_C, 0x20 );  // LCD Basic Commands
  LcdWrite(LCD_C, 0x0C );  // LCD in normal mode.
}

void LcdString(char *characters, bool negate=false)
{
  while (*characters)
  {
    LcdCharacter(*characters++, negate);
  }
}
void gotoXY(int x, int y)
{
  LcdWrite( 0, 0x80 | x);  // Column.
  LcdWrite( 0, 0x40 | y);  // Row.  

}
void LcdClear(void)
{
  for (int i=0;i<6;i++){
    gotoXY(0,i);
    sprintf(cha, "                        ");LcdString(cha, false);
  }
  
}
void LcdWrite(byte dc, byte data)
{
  digitalWrite(PIN_DC, dc);
  digitalWrite(PIN_SCE, LOW);
  shiftOut(PIN_SDIN, PIN_SCLK, MSBFIRST, data);
  digitalWrite(PIN_SCE, HIGH);
}

Rtc_Pcf8563 rtc;
DHT dht(DHTPIN, DHTTYPE);

void setup(void)
{
  Serial.begin(9600);  
  
  LcdInitialise();
  LcdClear();

  rtc.initClock();
  rtc.setDate(30, 1, 12, 0, 15);
  rtc.setTime(0, 0, 57);
  rtc.setAlarm(0,1,99,99);
  
  dht.begin();
  
  
  pinMode(3,INPUT);
  pinMode(12, INPUT);  
  pinMode(10, OUTPUT);
}

int x, y, b;bool alarm,alarm2;
bool isUp(){ return y>200; }
bool isDown(){ return y<-200; }
bool isLeft(){ return x<-200; }
bool isRight(){ return x>200; }
bool isPressed() { return b==1; }

int mode=0;
int pos_menu=0;
int pos_setClock=0;
int pos_setDisp=0;
bool budzik=false;

int obetnij(int wejscie, int max, bool symetric=false){
  if (symetric){
    if (wejscie<0-max) return max;
    if (wejscie>max) return 0-max;
  }
  else{
    if (wejscie<0) return max;
    if (wejscie>max) return 0;
  }
  return wejscie;
}


void displayClock(){
  char* clock = rtc.formatTime(); int p=-14+7;
  LcdCharacterBig(p+=14,0,clock[0],false);delay(10);
  LcdCharacterBig(p+=14,0,clock[1],false);delay(10);
  LcdCharacterBig(p+=14,0,'-',false);delay(10);
  LcdCharacterBig(p+=14,0,clock[3],false);delay(10);
  LcdCharacterBig(p+=14,0,clock[4],false);delay(10);
  
  gotoXY(0,3);
  sprintf (cha, "fm: %06i", freeMemory());LcdString(cha);
  
  gotoXY(0,4);
  sprintf (cha, "sekund: %02i", rtc.getSecond());LcdString(cha);

  gotoXY(0,5);
  sprintf (cha, "%02i'C | %02i%%", (int)(dht.readTemperature()), (int)(dht.readHumidity()));LcdString(cha);
  
  /*if (budzik){
   sprintf(cha, "#");
   gotoXY(77,4); LcdString(cha,true); 
   gotoXY(77,5); LcdString(cha,true);  
  }
  else{
   sprintf(cha, " ");
   gotoXY(77,4); LcdString(cha,false); 
   gotoXY(77,5); LcdString(cha,false);  
  }*/
  
  if (b){mode=1;LcdClear();return;}
  if (isRight()&&isUp()){
    budzik=true;
    rtc.enableAlarm();
  }
  if (isLeft()&&isDown()){
    budzik=false;
    rtc.clearAlarm();
  }
}

void showMenu(){
  if (isPressed()) {
    mode=pos_menu+2;
    if (mode==5) mode=0; 
    LcdClear();
    return;  
  }

  gotoXY(0,0);
  sprintf(cha, " Menu glowne ");LcdString(cha, true);
  gotoXY(0,1);
  sprintf(cha, "    "); LcdString(cha, false);
  gotoXY(20,1);
  sprintf(cha, "budzik"); LcdString(cha, (pos_menu==0));
  gotoXY(0,2);
  sprintf(cha, "ust."); LcdString(cha, (pos_menu==1));
  gotoXY(30,2);
  sprintf(cha, " ^  "); LcdString(cha, false);
  gotoXY(50,2);
  sprintf(cha, "ust."); LcdString(cha, (pos_menu==2));
  gotoXY(0,3);
  sprintf(cha, "czas"); LcdString(cha, (pos_menu==1));
  gotoXY(30,3);
  sprintf(cha, "< > "); LcdString(cha, false);
  gotoXY(50,3);
  sprintf(cha, "wysw"); LcdString(cha, (pos_menu==2));
  gotoXY(0,4);
  sprintf(cha, "     v"); LcdString(cha, false);
  gotoXY(0,5);
  sprintf(cha, "    "); LcdString(cha, false);
  gotoXY(20,5);
  sprintf(cha, "powrot"); LcdString(cha, (pos_menu==3));
  
  if (isUp()) pos_menu=0;
  if (isDown()) pos_menu=3;
  if (isRight()) pos_menu=2;
  if (isLeft()) pos_menu=1;
}

void setClock(bool isClock){
  char hh[3];
  if (isClock)
    sprintf(hh, "%02i", rtc.getHour());
  else
    sprintf(hh, "%02i", rtc.getAlarmHour());
  char mm[3];
  if (isClock)
    sprintf(mm, "%02i", rtc.getMinute());
  else
    sprintf(mm, "%02i", rtc.getAlarmMinute());

  gotoXY(0,0);
  if (isClock){ sprintf(cha, " Ustaw czas ");LcdString(cha, true);}
  else        { sprintf(cha, "Ustaw budzik");LcdString(cha, true);}

  gotoXY(0,1);
  sprintf(cha, "                        ");LcdString(cha, false);
  gotoXY(0,1);
  LcdString(hh,(pos_setClock==0));
  gotoXY(15,1);
  sprintf(cha, ":"); LcdString(cha, false);
  gotoXY(20,1);
  LcdString(mm,(pos_setClock==1));
  gotoXY(70,1);
  sprintf(cha, "OK");LcdString(cha,(pos_setClock==2));  
  gotoXY(0,3);
  sprintf(cha, "<> poprz/nast");LcdString(cha);
  gotoXY(0,4);
  sprintf(cha, "^v wart +/-");LcdString(cha);
  gotoXY(0,5);
  sprintf(cha, "                        ");LcdString(cha, false);
  
  if (isClock){
    if (pos_setClock==0){
      if (isUp())  rtc.setTime(obetnij(rtc.getHour()+1, 23), rtc.getMinute(), rtc.getSecond());
      if (isDown()) rtc.setTime(obetnij(rtc.getHour()-1, 23), rtc.getMinute(), rtc.getSecond());
    }
    if (pos_setClock==1){
      if (isUp())  rtc.setTime(rtc.getHour(), obetnij(rtc.getMinute()+1,59), rtc.getSecond());
      if (isDown()) rtc.setTime(rtc.getHour(), obetnij(rtc.getMinute()-1,59), rtc.getSecond());   
    }
  }
  else{
    if (pos_setClock==0){
      if (isUp())  rtc.setAlarm(rtc.getAlarmMinute(), obetnij(rtc.getAlarmHour()+1, 23), 0xFF, 0xFF);
      if (isDown()) rtc.setAlarm(rtc.getAlarmMinute(), obetnij(rtc.getAlarmHour()-1, 23), 0xFF, 0xFF);
    }
    if (pos_setClock==1){
      if (isUp())  rtc.setAlarm(obetnij(rtc.getAlarmMinute()+1,59), rtc.getAlarmHour(), 0xFF, 0xFF);
      if (isDown()) rtc.setAlarm(obetnij(rtc.getAlarmMinute()-1,59), rtc.getAlarmHour(), 0xFF, 0xFF);   
    }    
  }
  if (pos_setClock==2){
    if (isPressed()) {
      mode=1;
      LcdClear();
      return;
    }
  }
  
  
  if (isRight())  pos_setClock++;
  if (isLeft()) pos_setClock--;
  if (pos_setClock>2) pos_setClock=0;
  if (pos_setClock<0) pos_setClock=2;
}

void setDisplay(){
  sprintf(cha, " Ustaw. wysw.");LcdString(cha, true);
  gotoXY(0,1);
  sprintf(cha, "                        ");LcdString(cha, false);
  gotoXY(0,1);
  sprintf(cha, "kontrast:");LcdString(cha,false);
  gotoXY(55,1);
  sprintf(cha, "%02i", contrast_val);LcdString(cha, (pos_setDisp==0));
  gotoXY(0,2);
  sprintf(cha, "OK");LcdString(cha,(pos_setDisp==1));  
  gotoXY(0,4);
  sprintf(cha, "<> poprz/nast");LcdString(cha);
  gotoXY(0,5);
  sprintf(cha, "^v wart +/-");LcdString(cha);
  
  if (pos_setDisp==0){
    if (isUp())  { contrast_val=obetnij(contrast_val+1, 5, true); LcdInitialise(); }
    if (isDown()) { contrast_val=obetnij(contrast_val-1, 5, true); LcdInitialise(); }
  }
  if (pos_setDisp==1){
    if (isPressed()) {
      mode=1;
      LcdClear();
      return;
    }
  }
  
  
  if (isRight())  pos_setDisp++;
  if (isLeft()) pos_setDisp--;
  if (pos_setDisp>1) pos_setDisp=0;
  if (pos_setDisp<0) pos_setDisp=1;
}

void loop(void){  
  //Serial.println(mode);
  
  x= 512-analogRead(1);
  y= 512-analogRead(0);
  b= not (digitalRead(12));
  
  /*alarm = not digitalRead(3);if(alarm){ alarm2=true;rtc.clearAlarm();}
  if (alarm2){
   if(isRight()){alarm2=false;rtc.clearAlarm();}
   else{
     for (int i=50; i<255; i+=50) {
       analogWrite(10  , i); 
       delay(5);
     }
     analogWrite(10  , 0); 
   }
   
   return;
  }*/
  
  if (mode==0)
    displayClock();
  else if (mode==1) 
     showMenu(); 
  else if (mode==2) 
     setClock(false); //setAlarm
  else if (mode==3) 
     setClock(true); //setClock
  else if (mode==4) 
     setDisplay(); 

  delay(100);
}